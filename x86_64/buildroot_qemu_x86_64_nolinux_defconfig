## x86_64/buildroot_qemu_x86_64_nolinux_defconfig
```kconfig
BR2_x86_64=y
BR2_KERNEL_HEADERS_VERSION=y
BR2_DEFAULT_KERNEL_VERSION="6.1.4"
BR2_TARGET_GENERIC_HOSTNAME="doctorpi"
BR2_SYSTEM_DHCP="eth0"
BR2_ROOTFS_OVERLAY="../modinstall"
BR2_ROOTFS_POST_BUILD_SCRIPT="board/qemu/x86_64/post-build.sh"
BR2_ROOTFS_POST_IMAGE_SCRIPT="board/qemu/post-image.sh"
BR2_ROOTFS_POST_SCRIPT_ARGS="$(BR2_DEFCONFIG)"
BR2_TARGET_ROOTFS_EXT2=y
BR2_PACKAGE_HOST_KMOD=y
BR2_PACKAGE_HOST_QEMU=y
BR2_PACKAGE_HOST_QEMU_SYSTEM_MODE=y
```
